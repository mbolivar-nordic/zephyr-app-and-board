## boards/arm/con_a/Kconfig.board
```kconfig
# CON-A board configuration (nRF52-DK by another name)

# Copyright (c) 2016 Nordic Semiconductor ASA
# SPDX-License-Identifier: Apache-2.0

config BOARD_CON_A
	bool "CON-A - actually nRF52-DK"
	depends on SOC_NRF52832_QFAA
```

## boards/arm/con_a/Kconfig.defconfig
```kconfig
# nRF52 DK NRF52832 board configuration

# Copyright (c) 2016 Nordic Semiconductor ASA
# SPDX-License-Identifier: Apache-2.0

if BOARD_CON_A

config BOARD
	default "con_a"

config BT_CTLR
	default BT

endif # BOARD_CON_A
```

## west.yml
```yaml
west:
  url: https://github.com/zephyrproject-rtos/west
  revision: v0.5.7

manifest:
  defaults:
    remote: upstream

  remotes:
    - name: upstream
      url-base: https://github.com/zephyrproject-rtos

  projects:
    - name: zephyr
      remote: upstream
      path: zephyr
      revision: master
      west-commands: scripts/west-commands.yml

    - name: mcuboot
      remote: upstream
      path: mcuboot
      revision: 480421999ec2d8d2a20091e4f3a0393db04de5c4

    - name: cmsis
      revision: master
      path: modules/hal/cmsis

    - name: net-tools
      revision: master
      path: tools/net-tools

    - name: hal_nordic
      revision: 00580f43b9d48f2079d611ce12f0fbc78d3040f1
      path: modules/hal/nordic

    - name: mbedtls
      revision: cf7020eb4c7ef93319f2d6d2403a21e12a879bf6
      path: modules/crypto/mbedtls

    - name: mcumgr
      revision: d4e97cd4fc80ff949415062b1c83fd42929e8fe4
      path: modules/lib/mcumgr

    - name: segger
      revision: 6fcf61606d6012d2c44129edc033f59331e268bc
      path: modules/debug/segger
```
